## conf/layer.conf
```bitbake
# We have a conf and classes directory, add to BBPATH
BBPATH .= ":${LAYERDIR}"

# We have recipes-* directories, add to BBFILES
BBFILES += "${LAYERDIR}/recipes-*/*/*.bb \
            ${LAYERDIR}/recipes-*/*/*.bbappend"

BBFILE_COLLECTIONS += "meta-lcn"
BBFILE_PATTERN_meta-lcn = "^${LAYERDIR}/"
BBFILE_PRIORITY_meta-lcn = "6"

LAYERDEPENDS_meta-lcn = "core"
LAYERSERIES_COMPAT_meta-lcn = "mickledore"
```
